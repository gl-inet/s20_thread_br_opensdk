## main/Kconfig.projbuild
```kconfig
menu "Firmware version Configuration"

    config SDK_VERSION
        string "SDK Version"
        default ""

    config SDK_URL
        string "SDK URL"
        default ""

    config SDK_HASH
        string "SDK Hash"
        default ""

    config SW_VERSION
        string "SW Version"
        default ""

endmenu
```

## sdkconfig.defaults
```kconfig
# ESP32-S3 is the host SoC on ESP-Thread-Border-Router board
CONFIG_IDF_TARGET="esp32s3"

#
# Serial flasher config
#
CONFIG_ESPTOOLPY_FLASHSIZE_16MB=y
# end of Serial flasher config

#
# Partition Table
#
CONFIG_PARTITION_TABLE_CUSTOM=y
CONFIG_PARTITION_TABLE_CUSTOM_FILENAME="partitions.csv"
CONFIG_PARTITION_TABLE_FILENAME="partitions.csv"
CONFIG_PARTITION_TABLE_OFFSET=0x8000
CONFIG_PARTITION_TABLE_MD5=y
# end of Partition Table

#
# Compiler options
#
CONFIG_COMPILER_OPTIMIZATION_SIZE=y

#
# Newlib
#
CONFIG_NEWLIB_NANO_FORMAT=y

#
# mbedTLS
#

CONFIG_MBEDTLS_CMAC_C=y
CONFIG_MBEDTLS_SSL_PROTO_DTLS=y
CONFIG_MBEDTLS_KEY_EXCHANGE_ECJPAKE=y
# end of TLS Key Exchange Methods

CONFIG_MBEDTLS_ECJPAKE_C=y
# end of mbedTLS

#
# OpenThread
#
CONFIG_OPENTHREAD_ENABLED=y
CONFIG_OPENTHREAD_BORDER_ROUTER=y
CONFIG_OPENTHREAD_CLI_OTA=y
CONFIG_OPENTHREAD_RCP_COMMAND=y
CONFIG_OPENTHREAD_RADIO_SPINEL_UART=y
CONFIG_OPENTHREAD_COMM_MAX_JOINER_ENTRIES=50
CONFIG_OPENTHREAD_PLATFORM_MSGPOOL_MANAGEMENT=y
CONFIG_OPENTHREAD_NUM_MESSAGE_BUFFERS=2048
CONFIG_OPENTHREAD_MLE_MAX_CHILDREN=32
CONFIG_OPENTHREAD_LINK_METRICS=y
CONFIG_OPENTHREAD_BR_AUTO_START=y
CONFIG_OPENTHREAD_BR_START_WEB=y
CONFIG_OPENTHREAD_RADIO_TREL=y
CONFIG_OPENTHREAD_SRP_CLIENT=n
CONFIG_OPENTHREAD_HEADER_CUSTOM=y
CONFIG_OPENTHREAD_CUSTOM_HEADER_FILE_NAME="openthread-custom-feature.h"
# end of OpenThread

#
# OpenThread Border Router Example
#
CONFIG_AUTO_UPDATE_RCP=y
# end of OpenThread Border Router Example

#
# lwIP
#
CONFIG_LWIP_IPV6_FORWARD=y

# Use 12 with IDF v5.3.1 and later, and use 8 with earlier versions of IDF.
CONFIG_LWIP_IPV6_NUM_ADDRESSES=12

CONFIG_LWIP_MULTICAST_PING=y
CONFIG_LWIP_NETIF_STATUS_CALLBACK=y
CONFIG_LWIP_HOOK_IP6_ROUTE_DEFAULT=y
CONFIG_LWIP_HOOK_ND6_GET_GW_DEFAULT=y
CONFIG_LWIP_HOOK_IP6_INPUT_CUSTOM=y
CONFIG_LWIP_IPV6_AUTOCONFIG=y
CONFIG_LWIP_HOOK_IP6_SELECT_SRC_ADDR_CUSTOM=y
CONFIG_LWIP_FORCE_ROUTER_FORWARDING=y
# end of lwIP

#
# mDNS
#
CONFIG_MDNS_MULTIPLE_INSTANCE=y
CONFIG_MDNS_MAX_SERVICES=200
# end of mDNS

#
# ESP System Settings
#
CONFIG_ESP_SYSTEM_EVENT_TASK_STACK_SIZE=3584
# end of ESP System Settings

#
# ESP Border Router Board Kit
#
CONFIG_ESP_BR_BOARD_DEV_KIT=y
# CONFIG_ESP_CONSOLE_USB_SERIAL_JTAG=y # Do not enable
# end of ESP Border Router Board Kit

#
# Ethernet
# 
CONFIG_EXAMPLE_USE_DM9051=y
CONFIG_EXAMPLE_ETH_SPI_SCLK_GPIO=12
CONFIG_EXAMPLE_ETH_SPI_MOSI_GPIO=11
CONFIG_EXAMPLE_ETH_SPI_MISO_GPIO=13
CONFIG_EXAMPLE_ETH_SPI_CS_GPIO=10
CONFIG_EXAMPLE_ETH_SPI_CLOCK_MHZ=20
CONFIG_EXAMPLE_CONNECT_ETHERNET=y
# end of Etherenet

#
# Wi-Fi
# 
CONFIG_EXAMPLE_CONNECT_WIFI=n
# end of Wi-Fi

#
# http server
#
CONFIG_HTTPD_MAX_REQ_HDR_LEN=1024

#
# S20 Thread Broder Router config
#
CONFIG_PIN_TO_RCP_RESET=2
CONFIG_PIN_TO_RCP_BOOT=3
CONFIG_PIN_TO_RCP_TX=8
CONFIG_PIN_TO_RCP_RX=48
CONFIG_EXTERNAL_COEX_REQUEST_PIN=40
CONFIG_EXTERNAL_COEX_GRANT_PIN=42
CONFIG_EXTERNAL_COEX_PRIORITY_PIN=41
CONFIG_EXTERNAL_COEX_TX_LINE_PIN=45
CONFIG_ESP_COEX_EXTERNAL_COEXIST_ENABLE=y
CONFIG_SPIRAM=y
CONFIG_SPIRAM_MODE_OCT=y
CONFIG_SPIRAM_SPEED_80M=y
CONFIG_ESP_DEFAULT_CPU_FREQ_MHZ_240=y
CONFIG_ESP_SYSTEM_EVENT_TASK_STACK_SIZE=3584
CONFIG_ESP_CONSOLE_SECONDARY_NONE=y

# Version
CONFIG_SDK_VERSION="v5.4.2"
CONFIG_SDK_URL="https://github.com/espressif/esp-idf.git"
CONFIG_SDK_HASH="f5c3654a1c2d2a01f7f67def7a0dc48e691f63c0"
CONFIG_SW_VERSION="v1.0.0"
# end of S20 Thread Broder Router config
```
